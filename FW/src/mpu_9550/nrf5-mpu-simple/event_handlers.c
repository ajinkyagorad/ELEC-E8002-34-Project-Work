#include "headers.h"

extern bool bpm_update_flag;
extern bool start_btn_flag;
extern void sleep_mode_enter(void);




/**@brief Function for handling events from the BSP module.
 *
 * @param[in]   event   Event generated by button press.
 */
void bsp_event_handler(bsp_event_t event)
{
	  printf(" event %d \r\n",event);
    switch (event)
    {
			  case BSP_EVENT_KEY_0:
					start_btn_flag ^=1;
				  printf(" start flag set %d \r\n",start_btn_flag);
				break;
        case BSP_EVENT_ADVERTISING_START:

        break;
				
				case BSP_EVENT_ADVERTISING_STOP:
           
        break;

        default:
            break;
    }
}



static uint16_t       m_conn_handle = BLE_CONN_HANDLE_INVALID;   
/**@brief Function for handling the Application's BLE Stack events.
 *
 * @param[in] p_ble_evt  Bluetooth stack event.
 */
void on_ble_evt(ble_evt_t * p_ble_evt)
{
    uint32_t err_code;

    switch (p_ble_evt->header.evt_id)
            {
        case BLE_GAP_EVT_CONNECTED:
					//no point to connect
            err_code = sd_ble_gap_disconnect(m_conn_handle, BLE_HCI_REMOTE_USER_TERMINATED_CONNECTION);
            if (err_code != NRF_ERROR_INVALID_STATE)
            {
                APP_ERROR_CHECK(err_code);
            }
            break;


        default:
            // No implementation needed.
            break;
    }
}

/**@brief Function for handling advertising events.
 *
 * @details This function will be called for advertising events which are passed to the application.
 *
 * @param[in] ble_adv_evt  Advertising event.
 */
void on_adv_evt(ble_adv_evt_t ble_adv_evt)
{


    switch (ble_adv_evt)
    {
			  case BLE_ADV_EVT_DIRECTED:

            break;
        case BLE_ADV_EVT_FAST:

            break;
        case BLE_ADV_EVT_IDLE:
            sleep_mode_enter();
            break;
        default:
            break;
    }
}



/**@brief Function for dispatching a BLE stack event to all modules with a BLE stack event handler.
 *
 * @details This function is called from the BLE Stack event interrupt handler after a BLE stack
 *          event has been received.
 *
 * @param[in] p_ble_evt  Bluetooth stack event.
 */
void ble_evt_dispatch(ble_evt_t * p_ble_evt)
{
   // dm_ble_evt_handler(p_ble_evt);
    ble_conn_params_on_ble_evt(p_ble_evt);
    on_ble_evt(p_ble_evt);
    ble_advertising_on_ble_evt(p_ble_evt);
    //ble_mpu_on_ble_evt(&m_mpu, p_ble_evt);
}




/**@brief Function for dispatching a system event to interested modules.
 *
 * @details This function is called from the System event interrupt handler after a system
 *          event has been received.
 *
 * @param[in] sys_evt  System stack event.
 */
void sys_evt_dispatch(uint32_t sys_evt)
{
    //pstorage_sys_event_handler(sys_evt);
    ble_advertising_on_sys_evt(sys_evt);
}



void assert_nrf_callback(uint16_t line_num, const uint8_t * p_file_name)
{
    //app_error_handler(DEAD_BEEF, line_num, p_file_name);
}
